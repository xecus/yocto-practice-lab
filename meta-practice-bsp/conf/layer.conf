## meta-practice-bsp/conf/layer.conf
```bitbake
# yocto-practice-lab の自作レイヤー（BSP 側: MACHINE・ブートローダー・デバイスツリー）
# bitbake-layers create-layer のテンプレート（openembedded-core/meta/lib/bblayers/templates/layer.conf）と同じ形

BBPATH .= ":${LAYERDIR}"

BBFILES += "${LAYERDIR}/recipes-*/*/*.bb \
            ${LAYERDIR}/recipes-*/*/*.bbappend"

BBFILE_COLLECTIONS += "practice-bsp"
BBFILE_PATTERN_practice-bsp = "^${LAYERDIR}/"
BBFILE_PRIORITY_practice-bsp = "6"

LAYERDEPENDS_practice-bsp = "core"
LAYERSERIES_COMPAT_practice-bsp = "wrynose"
```

## meta-practice/conf/layer.conf
```bitbake
# yocto-practice-lab の自作レイヤー（ディストリビューション・アプリ側）
# bitbake-layers create-layer のテンプレート（openembedded-core/meta/lib/bblayers/templates/layer.conf）と同じ形

BBPATH .= ":${LAYERDIR}"

BBFILES += "${LAYERDIR}/recipes-*/*/*.bb \
            ${LAYERDIR}/recipes-*/*/*.bbappend"

BBFILE_COLLECTIONS += "practice"
BBFILE_PATTERN_practice = "^${LAYERDIR}/"
BBFILE_PRIORITY_practice = "6"

LAYERDEPENDS_practice = "core"
LAYERSERIES_COMPAT_practice = "wrynose"
```
